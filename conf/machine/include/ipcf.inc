## conf/machine/include/ipcf.inc
```bitbake
IPCF_M7_APP_BIN_DIR ?= "."
IPCF_M7_APP_BIN_NAME ?= "IPCF_Example_S32G274A_M7_0.bin"
IPCF_M7_APP_BIN_NAME_S32G3 ?= "IPCF_Example_S32G399A_M7_0.bin"
```

## conf/machine/include/srm.inc
```bitbake
SCMI_USE_SCMI_PINCTRL ??= "0"
SCMI_USE_SCMI_GPIO ??= "0"
SCMI_USE_SCMI_NVMEM ??= "0"
SCMI_DTB_NODE_CHANGE ??= "false"
```

## conf/machine/nxp-s32g.conf
```bitbake
#@TYPE: Machine
#@NAME: nxp-s32g
#@DESCRIPTION: Machine configuration for NXP S32G2/G3 SoC

DEFAULTTUNE = "cortexa53"
require conf/machine/include/arm/armv8a/tune-cortexa53.inc

require conf/machine/include/llce.inc
require conf/machine/include/ipcf.inc
require conf/machine/include/hse.inc

MACHINE_FEATURES = "ext3 pci usbgadget usbhost vfat"

KERNEL_IMAGETYPE = ""
KERNEL_IMAGETYPES = " ${@bb.utils.contains('ATF_SIGN_ENABLE', '1', 'fitImage', 'Image.gz Image', d)}"
KERNEL_CLASSES = "${@bb.utils.contains('ATF_SIGN_ENABLE', '1', ' kernel-fitimage', ' ', d)}"

DTB_FILES = "s32g2xxa-evb.dtb s32g274a-rdb2.dtb s32g399a-rdb3.dtb s32g3xxa-evb.dtb \
             s32g2xxa-evb-pfems.dtb s32g274a-rdb2-pfems.dtb s32g399a-rdb3-pfems.dtb s32g3xxa-evb-pfems.dtb"

KERNEL_DEVICETREE = "${@''.join('freescale/%s ' % d for d in '${DTB_FILES}'.split())}"

SERIAL_CONSOLES ?= "115200;ttyLF0"
SERIAL_CONSOLES_CHECK ?= "${SERIAL_CONSOLES}"

IMAGE_FSTYPES += "tar.bz2"

# multilib support
MULTILIBS ?= "multilib:lib32"
DEFAULTTUNE:virtclass-multilib-lib32 ?= "armv7athf-neon"
EXTRA_IMAGECMD:jffs2 = "--pad --no-cleanmarkers --eraseblock=128"

UBOOT_CONFIG ??= "s32g274ardb2 s32g2xxaevb s32g399ardb3 s32g3xxaevb"

S32G2XXAEVB_UBOOT_DEFCONFIG_NAME = "s32g2xxaevb_defconfig"
S32G274ARDB2_UBOOT_DEFCONFIG_NAME = "s32g274ardb2_defconfig"
S32G399ARDB3_UBOOT_DEFCONFIG_NAME = "s32g399ardb3_defconfig"
S32G3XXAEVB_UBOOT_DEFCONFIG_NAME = "s32g3xxaevb_defconfig"

UBOOT_CONFIG[s32g2xxaevb] = "${S32G2XXAEVB_UBOOT_DEFCONFIG_NAME}"
UBOOT_CONFIG[s32g274ardb2] = "${S32G274ARDB2_UBOOT_DEFCONFIG_NAME}"
UBOOT_CONFIG[s32g399ardb3] = "${S32G399ARDB3_UBOOT_DEFCONFIG_NAME}"
UBOOT_CONFIG[s32g3xxaevb] = "${S32G3XXAEVB_UBOOT_DEFCONFIG_NAME}"

UBOOT_MAKE_TARGET ?= "all"
UBOOT_BINARY = "u-boot-nodtb.bin"
UBOOT_CFGOUT = "u-boot-s32.cfgout"
PREFERRED_VERSION_u-boot-s32 ?= "2020.04"
PREFERRED_PROVIDER_virtual/bootloader = "u-boot-s32"
BB_MULTI_PROVIDER_ALLOWED += "virtual/bootloader"

PREFERRED_PROVIDER_u-boot-tools = "u-boot-s32-tools"
PREFERRED_PROVIDER_u-boot-tools-native = "u-boot-s32-tools-native"
PREFERRED_PROVIDER_u-boot-mkimage-native = "u-boot-s32-tools-native"
PREFERRED_PROVIDER_u-boot-mkenvimage-native = "u-boot-s32-tools-native"
PREFERRED_PROVIDER_nativesdk-u-boot-tools = "nativesdk-u-boot-s32-tools"
PREFERRED_PROVIDER_nativesdk-u-boot-mkimage = "nativesdk-u-boot-s32-tools"
PREFERRED_PROVIDER_nativesdk-u-boot-mkenvimage = "nativesdk-u-boot-s32-tools"

MACHINE_EXTRA_RRECOMMENDS = " kernel-modules kernel-devicetree"
IMAGE_FSTYPES += "tar.bz2 wic wic.bmap"
WKS_FILE ?= "s32g-sdimage-bootpart.wks"
IMAGE_INSTALL:append = " ${@bb.utils.contains('ATF_SIGN_ENABLE', '1', 'kernel-devicetree kernel-image-fitimage', 'kernel-devicetree kernel-image-image', d)}"
do_image_wic[depends] += "mtools-native:do_populate_sysroot dosfstools-native:do_populate_sysroot"

FIT_IMAGES = "${@''.join('fitImage-%s ' % d for d in '${UBOOT_CONFIG}'.split())}"
IMAGE_BOOT_FILES ?= " ${@bb.utils.contains('ATF_SIGN_ENABLE', '1', '${FIT_IMAGES}', 'Image ${DTB_FILES}', d)}"
IMAGE_BOOT_FILES:append = " ${@bb.utils.contains('IMAGE_INSTALL', 'pfe', 's32g_pfe_class.fw s32g_pfe_util.fw', '', d)}"
IMAGE_BOOT_FILES:append = " ${@bb.utils.contains('IMAGE_INSTALL', 'ipc-shm', '${IPCF_M7_APP_BIN_NAME}', '', d)}"
IMAGE_BOOT_FILES:append = " ${@bb.utils.contains('IMAGE_INSTALL', 'ipc-shm', '${IPCF_M7_APP_BIN_NAME_S32G3}', '', d)}"
IMAGE_BOOT_FILES:append = " ${@bb.utils.contains('HSE_SEC_ENABLED', '1', '${HSE_SEC_PUB_KEY}', '', d)}"
IMAGE_BOOT_FILES:append = " ${@bb.utils.contains('HSE_SEC_ENABLED', '1', '${HSE_SEC_PUB_KEY_PEM}', '', d)}"

PREFERRED_PROVIDER_virtual/atf-s32g ?= "atf-s32g"
PREFERRED_PROVIDER_virtual/kernel ??= "linux-yocto"
PREFERRED_VERSION_linux-yocto ?= "5.15%"

# For ostree
INITRAMFS_IMAGE ??= ""
IMAGE_BOOT_FILES:append = " ${@bb.utils.contains('DISTRO_FEATURES', 'ostree', '${INITRAMFS_IMAGE}-${MACHINE}.${INITRAMFS_FSTYPES};initramfs boot.scr', '', d)} \
"

OSTREE_KERNEL ?= "Image"

SKIP_SCRIPT_FDT ?= "yes"

OSTREE_BOOTSCR_PRECMD ?= " \
${@bb.utils.contains('IMAGE_INSTALL', 'pfe', 'pfeng stop;', '', d)} \
setenv initrd_addr 0x85010000; \
setenv use_fdtdtb 1; \
setenv skip_script_fdt ${SKIP_SCRIPT_FDT}; \
"

# u-boot will set the correct fdt_file according to the boards
DEFAULT_DTB ?= ""

OSTREE_COPY_IMAGE_BOOT_FILES = "1"
OSTREE_UBOOT_CMD ?= "booti"

# For ustart.img
OSTREE_NETINST_DEV ?= "/dev/mmcblk0,/dev/sda,/dev/vda"
OSTREE_NETINST_ARGS ?= "${OSTREE_CONSOLE} bl=ufsd rdinit=/install instdev=${OSTREE_NETINST_DEV} instname=wrlinux instbr=\$BRANCH insturl=\$URL instab=${OSTREE_USE_AB} instsf=1 instdate=BUILD_DATE"

# # The loader is flashed into the device separately
OSTREE_SD_UBOOT_WIC1 ?= ""
OSTREE_SD_UBOOT_WIC2 ?= ""
OSTREE_SD_UBOOT_WIC3 ?= ""
OSTREE_SD_UBOOT_WIC4 ?= ""
# Reserve 10MB disk as boot loader block offset for atf bootloader
OSTREE_SD_BOOT_ALIGN ?= "10240"
OSTREE_FDISK_BLM ?= "20480"
```
